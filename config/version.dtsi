#define VERSION_MACRO
macro_ver: macro_ver {
compatible = "zmk,behavior-macro";
label = "macro_ver";
#binding-cells = <0>;
bindings = <&kp N2>, <&kp N0>, <&kp N2>, <&kp N4>, <&kp N0>, <&kp N1>, <&kp N2>, <&kp N0>, <&kp MINUS>, <&kp K>, <&kp I>, <&kp N>, <&kp E>, <&kp MINUS>, <&kp N7>, <&kp N4>, <&kp N4>, <&kp N7>, <&kp N6>, <&kp N6>, <&kp N9>, <&kp RET>;
};
